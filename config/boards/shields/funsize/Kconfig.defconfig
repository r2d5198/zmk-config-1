## config/boards/shields/funsize/Kconfig.defconfig
```kconfig
if SHIELD_FUNSIZE_LEFT

config ZMK_KEYBOARD_NAME
	default "Funsize Left"

endif

if SHIELD_FUNSIZE_RIGHT

config ZMK_KEYBOARD_NAME
	default "Funsize Right"

config ZMK_SPLIT_BLE_ROLE_CENTRAL
	default y

endif

if SHIELD_FUNSIZE_LEFT || SHIELD_FUNSIZE_RIGHT

config ZMK_SPLIT
	default y

endif
```

## config/boards/shields/funsize/Kconfig.shield
```kconfig
# Copyright (c) 2021 Caleb Lightfoot
# SPDX-License-Identifier: MIT

config SHIELD_FUNSIZE_LEFT
	def_bool $(shields_list_contains,funsize_left)

config SHIELD_FUNSIZE_RIGHT
	def_bool $(shields_list_contains,funsize_right)
```

## config/boards/shields/nrfmicro/Kconfig.defconfig
```kconfig
if SHIELD_NRFMICRO

config ZMK_KEYBOARD_NAME
	default "test"

config ZMK_KSCAN_DIRECT_POLLING
	default y
	
endif
```

## config/boards/shields/test/Kconfig.defconfig
```kconfig
if SHIELD_TEST

config ZMK_KEYBOARD_NAME
	default "nRFmicro"

config ZMK_KSCAN_DIRECT_POLLING
	default y
	
endif
```
