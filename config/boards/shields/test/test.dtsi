#include <dt-bindings/zmk/matrix-transform.h>

/ {
	chosen {
		zmk,kscan = &kscan0;
	};
	kscan0: kscan_0 {
		compatible = "zmk,kscan-gpio-direct";

		label = "KSCAN";

		input-gpios
			= <&gpio0 6 (GPIO_ACTIVE_LOW | GPIO_PULL_UP)>
			, <&gpio0 8 (GPIO_ACTIVE_LOW | GPIO_PULL_UP)>
			, <&gpio0 15 (GPIO_ACTIVE_LOW | GPIO_PULL_UP)>
			, <&gpio0 17 (GPIO_ACTIVE_LOW | GPIO_PULL_UP)>
			, <&gpio0 20 (GPIO_ACTIVE_LOW | GPIO_PULL_UP)>
			, <&gpio0 13 (GPIO_ACTIVE_LOW | GPIO_PULL_UP)>
			, <&gpio0 24 (GPIO_ACTIVE_LOW | GPIO_PULL_UP)>
			, <&gpio0 9 (GPIO_ACTIVE_LOW | GPIO_PULL_UP)>
			, <&gpio0 10 (GPIO_ACTIVE_LOW | GPIO_PULL_UP)>
			, <&gpio1 6 (GPIO_ACTIVE_LOW | GPIO_PULL_UP)>
			, <&gpio1 11 (GPIO_ACTIVE_LOW | GPIO_PULL_UP)>
			, <&gpio0 28 (GPIO_ACTIVE_LOW | GPIO_PULL_UP)>
			, <&gpio0 3 (GPIO_ACTIVE_LOW | GPIO_PULL_UP)>
			, <&gpio1 13 (GPIO_ACTIVE_LOW | GPIO_PULL_UP)>
			, <&gpio0 2 (GPIO_ACTIVE_LOW | GPIO_PULL_UP)>
			, <&gpio0 29 (GPIO_ACTIVE_LOW | GPIO_PULL_UP)>
			, <&gpio0 31 (GPIO_ACTIVE_LOW | GPIO_PULL_UP)>
			, <&gpio0 30 (GPIO_ACTIVE_LOW | GPIO_PULL_UP)>
			;
	};
};

